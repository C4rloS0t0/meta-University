## meta-University/conf/layer.conf
```bitbake
# We have a conf and classes directory, add to BBPATH
BBPATH .= ":${LAYERDIR}"

# We have recipes-* directories, add to BBFILES
BBFILES += "${LAYERDIR}/recipes-*/*/*.bb \
            ${LAYERDIR}/recipes-*/*/*.bbappend"

BBFILE_COLLECTIONS += "meta-University"
BBFILE_PATTERN_meta-University = "^${LAYERDIR}/"
BBFILE_PRIORITY_meta-University = "6"

LAYERDEPENDS_meta-University = "core"
LAYERSERIES_COMPAT_meta-University = "kirkstone"
```
